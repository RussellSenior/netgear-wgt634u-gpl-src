OUTPUT_ARCH(mips)
ENTRY(startup)
SECTIONS {
	. = TEXT_START;
	.text : {
		text_start = .;
		*(.text)
		*(.rodata)
		text_end = .;
	}

	.data : {
		data_start = .;
		*(.data)
		data_end = .;
	}

	.bss : {
		bss_start = .;
		*(.bss)
		bss_end = .;
	}
}
